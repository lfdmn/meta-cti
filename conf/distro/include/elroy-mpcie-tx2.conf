## conf/distro/include/elroy-mpcie-tx2.conf
```bitbake
DEPLOY_CONF_NAME = "NVIDIA Elroy mPCIe TX2"

include conf/distro/include/jetson.inc
```

## conf/layer.conf
```bitbake
# We have a conf and classes directory, add to BBPATH
BBPATH .= ":${LAYERDIR}"

# We have recipes-* directories, add to BBFILES
BBFILES += " \
    ${LAYERDIR}/recipes-*/*/*.bb \
	${LAYERDIR}/recipes-*/*/*.bbappend"

BBFILE_COLLECTIONS += "connecttech"
BBFILE_PATTERN_connecttech = "^${LAYERDIR}/"
BBFILE_PRIORITY_connecttech = "10"


LAYERDEPENDS_BBFILE_PRIORITY_connecttech = "tegra"
LAYERSERIES_COMPAT_connecttech = "warrior"
```

## conf/machine/elroy-mpcie-tx2.conf
```bitbake
#@TYPE: Machine
#@NAME: Nvidia Astro TX2
#@DESCRIPTION: Nvidia Jetson TX2 on ConnectTech Astro

# Comes from meta-tegra
require conf/machine/include/tegra186.inc

KERNEL_DEVICETREE ?= "_ddot_/_ddot_/_ddot_/_ddot_/nvidia/platform/t18x/quill/kernel-dts/tegra186-tx2-cti-ASG002-mPCIe.dtb"
KERNEL_ARGS ?= "console=ttyS0,115200 console=tty0 OS=l4t fbcon=map:0"

MACHINE_FEATURES += "ext2 ext3 vfat"

UBOOT_MACHINE = "p2771-0000-500_defconfig"

EMMC_SIZE ?= "31276924928"
EMMC_DEVSECT_SIZE ?= "512"
BOOTPART_SIZE ?= "8388608"
BOOTPART_LIMIT ?= "10485760"
ROOTFSPART_SIZE ?= "12884901888"
ODMDATA ?= "0x90000"
EMMC_BCT ?= "P3310_A00_8GB_Samsung_8GB_lpddr4_204Mhz_A02_l4t.cfg"
NVIDIA_BOARD ?= "t186ref"
TEGRA186_REDUNDANT_BOOT ?= "0"
PARTITION_LAYOUT_TEMPLATE ?= "flash_l4t_t186.xml"
```
